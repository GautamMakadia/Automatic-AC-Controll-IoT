// Dean Sir Office Code

#include <IRsend.h>  // IR Remote ESP8266 library
#include <DHT.h>     // DHT11 library

// DHT11 setup
#define DHTPIN 14  // NodeMCU pin D5
#define DHTTYPE DHT11
DHT dht(DHTPIN, DHTTYPE);

// IR LED setup
#define IR_LED 12  // IR LED pin D6
IRsend irsend(IR_LED);

// Desired temperature
#define Desired_temperature 27

// Decoded IR signals (fill these with actual raw codes from your remote)
uint16_t ACoff[] = { 3440, 1530, 532, 300, 528, 300, 524, 1130, 520, 310, 518, 1138, 492,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 1264, 392 };
uint16_t ACon[] = {3424, 1548,  520, 310,  520, 330,  496, 1140,  516, 334,  494, 1140,  518,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 440,  390};
uint16_t Temp23[] = { 3392, 1576, 494, 340, 492, 334, 494, 1156, 500, 330, 498, 1154, 502,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 438, 390 };
uint16_t Temp24[] = { 3382, 1600, 496, 340, 492, 336, 492, 1156, 500, 332, 498, 1154, 502,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 438, 390 };
uint16_t Temp25[] = { 3368, 1600, 496, 340, 490, 338, 492, 1154, 500, 332, 496, 1156, 500,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 438, 390 };
uint16_t Temp26[] = { 3366, 1602, 466, 394, 462, 342, 490, 1158, 502, 332, 496, 1154, 502,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 438, 390 };
uint16_t Temp27[] = { 3362, 1602, 464, 398, 432, 396, 464, 1160, 498, 336, 494, 1156, 502,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 438, 390 };  // PANASONIC C4D3:64800024
uint16_t Temp28[] = { 3382, 1602, 464, 396, 436, 392, 464, 1158, 500, 332, 496, 1154, 500,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 1266, 390 };
uint16_t Temp29[] = { 3418, 1552, 518, 334, 494, 332, 498, 1138, 520, 328, 498, 1156, 502,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 1264, 392 };
uint16_t Temp30[] = { 3422, 1546, 518, 312, 518, 332, 496, 1138, 518, 332, 494, 1140, 516,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 1268, 390 };


int Measured_temp = 27;
int Measured_Humi;
int AC_Temp;
char temp_error = 2;
int Pev_value;
boolean AC = false;
const uint16_t khz = 38;  // 38kHz carrier frequency

void setup() {
  Serial.begin(9600);
  dht.begin();
  irsend.begin();
}

void loop() {
  // Read temperature and humidity
  Measured_temp = dht.readTemperature() + temp_error;
  Measured_Humi = dht.readHumidity();

  // Print values to Serial Monitor
  Serial.print("Temperature: ");
  Serial.print(Measured_temp);
  Serial.println("C");
  Serial.print("Prev Value: ");
  Serial.print(Pev_value);
  Serial.println("C");
  Serial.print("Humidity: ");
  Serial.print(Measured_Humi);
  Serial.println("%");
  Serial.print("AC Temp: ");
  Serial.println(AC_Temp);
  Serial.println("------------------------");

  delay(3000);

  if (Measured_temp != Pev_value) {
    if (Measured_temp >= Desired_temperature + 3) // 3 more hot
    {
      irsend.sendRaw(Temp24, sizeof(Temp24) / sizeof(Temp24[0]), khz);
      AC_Temp = 24;
      delay(2000);
    } 
    if (Measured_temp == Desired_temperature + 2) //2 more hot
    {
      irsend.sendRaw(Temp25, sizeof(Temp25) / sizeof(Temp25[0]), khz);
      AC_Temp = 25;
      delay(2000);
    } 
    if (Measured_temp == Desired_temperature + 1) // 1 more hot 
    {
      irsend.sendRaw(Temp26, sizeof(Temp26) / sizeof(Temp26[0]), khz);
      AC_Temp = 26;
      delay(2000);  
    }
    if (Measured_temp == Desired_temperature) // equal
    {
      irsend.sendRaw(Temp27, sizeof(Temp27) / sizeof(Temp27[0]), khz);
      AC_Temp = 27;
    }
    if (Measured_temp == Desired_temperature - 1) // l cold
    {
      irsend.sendRaw(Temp28, sizeof(Temp28) / sizeof(Temp28[0]), khz);
      AC_Temp = 28;
      delay(2000);
    }
    if (Measured_temp == Desired_temperature - 2) // 2 cold
    {
      irsend.sendRaw(Temp29, sizeof(Temp29) / sizeof(Temp29[0]), khz);
      AC_Temp = 29;
      delay(2000);
    }
    if (Measured_temp <= Desired_temperature - 3) // 3 cold
    {
      irsend.sendRaw(Temp30, sizeof(Temp30) / sizeof(Temp30[0]), khz);
      AC_Temp = 30;
      delay(2000);
    }
  }

  Pev_value = Measured_temp;
}
