// Survelance Room 
#include <IRsend.h>  // IR Remote ESP8266 library
#include <DHT.h>     // DHT11 library

// DHT11 setup
#define DHTPIN 14  // NodeMCU pin D5
#define DHTTYPE DHT11
DHT dht(DHTPIN, DHTTYPE);

// IR LED setup
#define IR_LED 12  // IR LED pin D6
IRsend irsend(IR_LED);

// Desired temperature
#define Desired_temperature 27

// Decoded IR signals (fill these with actual raw codes from your remote)
uint16_t Temp31[583] = {3546, 1620,  526, 1198,  524, 1198,  522, 350,  514, 352,  466, 404,  514,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 1356,  390};
uint16_t Temp30[583] = {3520, 1644,  522, 1202,  492, 1234,  492, 374,  492, 372,  486, 380,  488,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 1338,  366};
uint16_t Temp29[583] = {3478, 1680,  472, 1256,  476, 1254,  494, 372,  490, 380,  484, 380,  474,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 1362,  366};
uint16_t Temp28[583] = {3514, 1648,  524, 1200,  474, 1252,  490, 376,  464, 404,  468, 400,  484,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 1362,  390};
uint16_t Temp27[583] = {3476, 1688,  520, 1204,  474, 1258,  468, 404,  516, 350,  488, 378,  552,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 1360,  388};
uint16_t Temp26[583] = {3528, 1630,  472, 1254,  504, 1226,  522, 346,  514, 354,  516, 350,  474,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 1342,  364};
uint16_t Temp25[583] = {3526, 1634,  522, 1202,  476, 1258,  520, 352,  488, 378,  490, 376,  552,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 1356,  390};
uint16_t Temp24[583] = {3520, 1644,  494, 1230,  468, 1254,  492, 376,  468, 402,  466, 404,  484,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 1356,  390};


int Measured_temp = 27;
int Measured_Humi;
int AC_Temp;
char temp_error = 2;
int Pev_value;
boolean AC = false;
const uint16_t khz = 38;  // 38kHz carrier frequency

void setup() {
  Serial.begin(9600);
  dht.begin();
  irsend.begin();
}

void loop() {
  // Read temperature and humidity
  Measured_temp = dht.readTemperature() + temp_error;
  Measured_Humi = dht.readHumidity();

  // Print values to Serial Monitor
  Serial.print("Temperature: ");
  Serial.print(Measured_temp);
  Serial.println("C");
  Serial.print("Prev Value: ");
  Serial.print(Pev_value);
  Serial.println("C");
  Serial.print("Humidity: ");
  Serial.print(Measured_Humi);
  Serial.println("%");
  Serial.print("AC Temp: ");
  Serial.println(AC_Temp);
  Serial.println("------------------------");

  delay(3000);

  if (Measured_temp != Pev_value) {
    if (Measured_temp >= Desired_temperature + 3) // 3 more hot
    {
      irsend.sendRaw(Temp24, sizeof(Temp24) / sizeof(Temp24[0]), khz);
      AC_Temp = 24;
      delay(2000);
    } 
    if (Measured_temp == Desired_temperature + 2) //2 more hot
    {
      irsend.sendRaw(Temp25, sizeof(Temp25) / sizeof(Temp25[0]), khz);
      AC_Temp = 25;
      delay(2000);
    } 
    if (Measured_temp == Desired_temperature + 1) // 1 more hot 
    {
      irsend.sendRaw(Temp26, sizeof(Temp26) / sizeof(Temp26[0]), khz);
      AC_Temp = 26;
      delay(2000);  
    }
    if (Measured_temp == Desired_temperature) // equal
    {
      irsend.sendRaw(Temp27, sizeof(Temp27) / sizeof(Temp27[0]), khz);
      AC_Temp = 27;
    }
    if (Measured_temp == Desired_temperature - 1) // l cold
    {
      irsend.sendRaw(Temp28, sizeof(Temp28) / sizeof(Temp28[0]), khz);
      AC_Temp = 28;
      delay(2000);
    }
    if (Measured_temp == Desired_temperature - 2) // 2 cold
    {
      irsend.sendRaw(Temp29, sizeof(Temp29) / sizeof(Temp29[0]), khz);
      AC_Temp = 29;
      delay(2000);
    }
    if (Measured_temp <= Desired_temperature - 3) // 3 cold
    {
      irsend.sendRaw(Temp30, sizeof(Temp30) / sizeof(Temp30[0]), khz);
      AC_Temp = 30;
      delay(2000);
    }
  }

  Pev_value = Measured_temp;
}
